## drivers/gpu/drm/rvkms/Kconfig
```kconfig
config DRM_RVKMS
	tristate "Rust VKMS PoC driver (EXPERIMENTAL)"
	depends on RUST && DRM=y && MMU
	select RUST_DRM_KMS
	select RUST_DRM_GEM_SHMEM_HELPER
```

## drivers/gpu/nova-core/Kconfig
```kconfig
config NOVA_CORE
	tristate "Nova Core GPU driver"
	depends on 64BIT
	depends on PCI
	depends on RUST
	depends on !CPU_BIG_ENDIAN
	depends on FWCTL=y
	select AUXILIARY_BUS
	select GPU_BUDDY
	select RUST_FWCTL_ABSTRACTIONS
	select RUST_FW_LOADER_ABSTRACTIONS
	default n
	help
	  Choose this if you want to build the Nova Core driver for Nvidia
	  GPUs based on the GPU System Processor (GSP). This is true for Turing
	  and later GPUs.

	  This driver is work in progress and may not be functional.

	  If M is selected, the module will be called nova-core.

config NOVA_CORE_IRQ_SELFTEST
	bool "Nova Core CPU doorbell IRQ self-test"
	depends on NOVA_CORE
	help
	  Run a CPU doorbell interrupt self-test during nova-core probe. The
	  test injects a known vector through the GPU interrupt controller's
	  software trigger and confirms the interrupt is delivered to the host
	  handler, validating the MSI path from the GPU through PCIe to the CPU
	  with no dependency on GSP firmware. The result is printed to dmesg.

	  NOTE: this test actually changes the driver's behavior! Specifically,
	  it fails the PCI probe step (which, in turn, fails the driver load) if
	  the test fails.

	  This is intended for driver bring-up and for debugging PCI, MSI, or
	  passthrough setups. If unsure, say N.
```
